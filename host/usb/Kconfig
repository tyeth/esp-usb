## host/usb/Kconfig
```kconfig
menu "USB-OTG"
    depends on SOC_USB_OTG_SUPPORTED

    config USB_HOST_CONTROL_TRANSFER_MAX_SIZE
        int "Largest size (in bytes) of transfers to/from default endpoints"
        default 256
        help
            Each USB device attached is allocated a dedicated buffer for its OUT/IN transfers to/from the device's
            control endpoint. The maximum size of that buffer is determined by this option. The limited size of the
            transfer buffer have the following implications:

            - The maximum length of control transfers is limited
            - Device's with configuration descriptors larger than this limit cannot be supported

    menu "Host channel allocation"

        config USB_HOST_DYNAMIC_CHAN_BINDING
            bool "Bind host channels on demand (experimental)"
            default n
            help
                The USB-DWC controller has a small, fixed number of host channels (e.g., 16 on the High-Speed
                controller of the ESP32-P4 and ESP32-S31). By default, every open pipe holds a channel for its whole
                lifetime: the default endpoint of every connected device, the interrupt endpoint of every external
                hub and every endpoint of every claimed interface. With external hubs and composite devices the
                channels run out while most pipes are idle, and claiming an interface then fails with
                ESP_ERR_NOT_SUPPORTED.

                When enabled, control and bulk pipes bind a channel only while they have transfers enqueued, and
                release it when they go idle. When no channel is free, the pipe waits in a queue and its transfers
                stay pending until a channel is released. Interrupt and isochronous pipes keep their channel for
                their whole lifetime (see USB_HOST_PARKED_INTR_BIND_CAP for interrupt IN pipes).

                A bulk IN pipe that keeps a read posted (e.g., a serial console) still holds its channel while it
                waits for data. See USB_HOST_PARKED_IN_BIND_CAP to share channels between such pipes.

                When disabled, channels are allocated statically, as in previous releases.

        config USB_HOST_PARKED_IN_BIND_CAP
            int "Max parked bulk IN listeners holding channels (0 = no limit, rotation disabled)"
            depends on USB_HOST_DYNAMIC_CHAN_BINDING
            default 0
            range 0 16
            help
                A parked listener is a bulk IN pipe that keeps several small reads posted (each at most
                USB_HOST_PARKED_IN_MAX_PACKETS max-size packets, with at least two reads queued), such as a
                CDC-ACM serial console waiting for data. While such a pipe holds a channel, the controller polls
                the device continuously, and enough of them saturate a Full-Speed bus.

                When set to N > 0, at most N parked listeners hold channels at once. The others wait in the channel
                queue, and a periodic tick (USB_HOST_PARKED_IN_ROTATE_MS) asks one parked listener at a time to
                give up its channel, so that every listener still gets regular bus time. A parked listener that
                gives up its channel in the middle of a transfer completes the packets already received as a short
                read. Larger transfers (e.g., mass storage data) are never limited or interrupted.

                0 disables parked-listener handling: no limit and no rotation.

        config USB_HOST_PARKED_IN_ROTATE_MS
            int "Parked listener rotation period (ms)"
            depends on USB_HOST_DYNAMIC_CHAN_BINDING && USB_HOST_PARKED_IN_BIND_CAP != 0
            default 100
            range 5 1000
            help
                Period of the tick that asks one parked listener to give up its channel while other pipes wait
                for a channel, or while more parked listeners than USB_HOST_PARKED_IN_BIND_CAP hold channels. At
                most one parked listener gives up its channel per tick, and the tick does nothing while a
                non-parked bulk transfer is executing. The worst-case extra latency for a parked listener is
                roughly (number of waiting listeners) x this period.

        config USB_HOST_PARKED_IN_MAX_PACKETS
            int "Max packets of a bulk IN read for a parked listener"
            depends on USB_HOST_DYNAMIC_CHAN_BINDING && USB_HOST_PARKED_IN_BIND_CAP != 0
            default 4
            range 1 16
            help
                A bulk IN read counts as a parked listener read when its length is at most this many max-size
                packets. Console drivers post reads of a few packets (e.g., Linux cdc-acm posts 2 x MPS reads),
                while mass storage data transfers are far larger.

        config USB_HOST_PARKED_IN_CHAN_RESERVE
            int "Host channels reserved from parked listeners"
            depends on USB_HOST_DYNAMIC_CHAN_BINDING && USB_HOST_PARKED_IN_BIND_CAP != 0
            default 0
            range 0 8
            help
                A parked listener (bulk or interrupt) may only bind a channel while MORE than this many channels
                are free, so the last channels stay available to pipes that are allocated statically (e.g.,
                interrupt pipes when a device's interface is claimed), whose allocation fails outright when no
                channel is free. Other pipes may use the reserved channels.

        config USB_HOST_PARKED_INTR_BIND_CAP
            int "Max parked interrupt IN listeners holding channels (0 = interrupt pipes bound statically)"
            depends on USB_HOST_DYNAMIC_CHAN_BINDING && USB_HOST_PARKED_IN_BIND_CAP != 0
            default 0
            range 0 16
            help
                When set to N > 0, interrupt IN pipes also bind a channel only while they have transfers
                enqueued. A parked interrupt listener is an interrupt IN pipe whose transfer is a single packet
                (e.g., a hub status change endpoint or a CDC-ACM notification endpoint). At most N of them hold
                channels at once, and they are rotated with the parked bulk IN listeners. Other interrupt IN
                pipes bind without a limit and are never rotated.

                A rotated-out listener polls its endpoint less often. Hub status changes are latched by the hub
                until they are read, so their detection is delayed but not lost.

                0 keeps every interrupt pipe bound statically.

    endmenu #Host channel allocation

    choice USB_HOST_HW_BUFFER_BIAS
        prompt "Hardware FIFO size biasing"
        default USB_HOST_HW_BUFFER_BIAS_BALANCED
        help
            The underlying hardware has size adjustable FIFOs to cache USB packets on reception (IN) or for
            transmission (OUT). The size of these FIFOs will affect the largest MPS (maximum packet size) and the
            maximum number of packets that can be cached at any one time. The hardware contains the following
            FIFOS: RX (for all IN packets), Non-periodic TX (for Bulk and Control OUT packets), and Periodic TX
            (for Interrupt and Isochronous OUT packets). This configuration option allows biasing the FIFO sizes
            towards a particular use case, which may be necessary for devices that have endpoints with large MPS.

            The FIFO allocation formulas (where D = otg_dfifo_depth, Total = Total available FIFO size in lines):

            Balanced:
              - IN (RX FIFO) = Total - D/4 - D/8
              - OUT non-periodic (Non-periodic TX FIFO) = D/4
              - OUT periodic (Periodic TX FIFO) = D/8

            Bias IN:
              - IN (RX FIFO) = Total - D/16 - D/8
              - OUT non-periodic (Non-periodic TX FIFO) = D/16
              - OUT periodic (Periodic TX FIFO) = D/8

            Bias Periodic OUT:
              - IN (RX FIFO) = D/8 + 3 (status quadlets: packet status + transfer complete + channel halted).

                - Even though the Programming Guide ch. 2.1.2.1 specifies only +2, testing showed that 2 lines
                  are not enough: with D/8 + 2 (130 lines), a device with a 512-byte interrupt-IN EP was accepted
                  but its IN transfers never completed.

                - No per-channel lines needed in Scatter-Gather DMA mode.

              - OUT non-periodic (Non-periodic TX FIFO) = D/16
              - OUT periodic (Periodic TX FIFO) = Total - D/16 - (D/8 + 3)

            Note:
              - Each line = 4 bytes. To convert FIFO size: bytes = lines × 4
              - D (otg_dfifo_depth) is typically 256 for FS PHY, 1024 for HS PHY (chip-dependent)
              - Total is slightly less than D due to controller overhead

        config USB_HOST_HW_BUFFER_BIAS_BALANCED
            bool "Balanced"
        config USB_HOST_HW_BUFFER_BIAS_IN
            bool "Bias IN"
        config USB_HOST_HW_BUFFER_BIAS_PERIODIC_OUT
            bool "Periodic OUT"
    endchoice

    menu "Hub Driver Configuration"

        menu "Root Port configuration"

            config USB_HOST_DEBOUNCE_DELAY_MS
                int "Debounce delay in ms"
                default 250
                help
                    On connection of a USB device, the USB 2.0 specification requires
                    a "debounce interval with a minimum duration of 100ms" to allow the connection to stabilize
                    (see USB 2.0 chapter 7.1.7.3 for more details).
                    During the debounce interval, no new connection/disconnection events are registered.

                    The default value is set to 250 ms to be safe.

            config USB_HOST_RESET_HOLD_MS
                int "Reset hold in ms"
                default 30
                help
                    The reset signaling can be generated on any Hub or Host Controller port by request from
                    the USB System Software. The USB 2.0 specification requires that "the reset signaling must
                    be driven for a minimum of 10ms" (see USB 2.0 chapter 7.1.7.5 for more details).
                    After the reset, the hub port will transition to the Enabled state (refer to Section 11.5).

                    The default value is set to 30 ms to be safe.

            config USB_HOST_RESET_RECOVERY_MS
                int "Reset recovery delay in ms"
                default 30
                help
                    After a port stops driving the reset signal, the USB 2.0 specification requires that
                    the "USB System Software guarantees a minimum of 10 ms for reset recovery" before the
                    attached device is expected to respond to data transfers (see USB 2.0 chapter 7.1.7.3 for
                    more details).
                    The device may ignore any data transfers during the recovery interval.

                    The default value is set to 30 ms to be safe.


            config USB_HOST_SET_ADDR_RECOVERY_MS
                int "SetAddress() recovery time in ms"
                default 10
                help
                    "After successful completion of the Status stage, the device is allowed a SetAddress()
                    recovery interval of 2 ms. At the end of this interval, the device must be able to accept
                    Setup packets addressed to the new address. Also, at the end of the recovery interval, the
                    device must not respond to tokens sent to the old address (unless, of course, the old and new
                    address is the same)." See USB 2.0 chapter 9.2.6.3 for more details.

                    The default value is set to 10 ms to be safe.

            config USB_HOST_RESUME_HOLD_MS
                int "Resume hold delay in ms"
                default 30
                help
                    "The host may signal resume (TDRSMDN) at any time. It must send the resume signaling for at least
                    20 ms and then end the resume signaling.."
                    See USB 2.0 chapter 7.1.7.7 for more details.

                    The default value is set to 30 ms to be safe.

            config USB_HOST_RESUME_RECOVERY_MS
                int "Resume recovery delay in ms"
                default 20
                help
                    "The USB System Software must provide a 10 ms resume recovery time (TRSMRCY) during which it will
                    not attempt to access any device connected to the affected (just-activated) bus segment."
                    See the USB 2.0 chapter 7.1.7.7 for more details.

                    The default value is set to 20 ms to be safe.

            config USB_HOST_SUSPEND_ENTRY_MS
                int "Suspend entry delay in ms"
                default 20
                help
                    "The device must actually be suspended, drawing only suspend current from the bus after no more
                    than 10 ms of bus inactivity on all its ports." See the USB 2.0 chapter 7.1.7.6 for more details.

                    The default values is set to 20 ms to be safe.

        endmenu #Root Hub configuration

        config USB_HOST_HUBS_SUPPORTED
            bool "Support Hubs"
            default n
            help
                Enables support of external Hubs.

        config USB_HOST_HUB_MULTI_LEVEL
            depends on USB_HOST_HUBS_SUPPORTED
            bool "Support multiple Hubs"
            default y
            help
                Enables support for connecting multiple Hubs simultaneously.

        menu "Downstream Port configuration"
            depends on USB_HOST_HUBS_SUPPORTED

            config USB_HOST_EXT_PORT_RESET_ATTEMPTS
                depends on IDF_EXPERIMENTAL_FEATURES
                # Invisible config option
                # Todo: IDF-11283
                int
                default 1
                help
                    Amount of attempts to reset the device.

                    The default value is 1.

            config USB_HOST_EXT_PORT_RESET_RECOVERY_DELAY_MS
                int "Reset recovery delay in ms"
                default 30
                help
                    After a port stops driving the reset signal, the USB 2.0 specification requires that
                    the "USB System Software guarantees a minimum of 10 ms for reset recovery" before the
                    attached device is expected to respond to data transfers (see USB 2.0 chapter 7.1.7.3 for
                    more details).
                    The device may ignore any data transfers during the recovery interval.

                    The default value is set to 30 ms to be safe.

            config USB_HOST_EXT_PORT_CUSTOM_POWER_ON_DELAY_ENABLE
                bool "Custom bPwrOn2PwrGood value"
                default n
                help
                    Enables the possibility to configure custom time for the power-on sequence on a port
                    until power is good on that port.

                    When enabled, applies the custom PwrOn2PwrGood delay.
                    When disabled, applies the PwrOn2PwrGood value from the Hub Descriptor.

            config USB_HOST_EXT_PORT_CUSTOM_POWER_ON_DELAY_MS
                depends on USB_HOST_EXT_PORT_CUSTOM_POWER_ON_DELAY_ENABLE
                int "PwrOn2PwrGood delay in ms"
                default 100
                range 0 5000
                help
                    Custom value of delay from the time the power-on sequence begins on a port
                    until power is good on that port.
                    Value 0 is used for a hub with no power switches.

                    The default value is 100 ms.

        endmenu #Downstream Port configuration

    endmenu #Hub Driver Configuration

    menu "Power management"

        config USB_HOST_AUTO_PM_LIGHT_SLEEP
            bool "Automatically suspend root port before light sleep"
            depends on ESP_SLEEP_EVENT_CALLBACKS
            default n
            help
                Register light sleep event callbacks to automatically suspend the root port when the SoC
                enters light sleep.

                Requires ESP_SLEEP_EVENT_CALLBACKS to be enabled in the menuconfig.

    endmenu #Power management

    config USB_HOST_ENABLE_ENUM_FILTER_CALLBACK
        bool "Enable enumeration filter callback"
        default n
        help
            The enumeration filter callback is called before enumeration of each newly attached device.
            This callback allows users to control whether a device should be enumerated, and what configuration
            number to use when enumerating a device.

            If enabled, the enumeration filter callback can be set via 'usb_host_config_t' when calling
            'usb_host_install()'.

    config USB_HOST_DWC_DMA_CAP_MEMORY_IN_PSRAM
        depends on (IDF_TARGET_ESP32P4 || IDF_TARGET_ESP32S31) && SPIRAM
        bool "Allocate USB_DWC DMA capable memory in PSRAM"
        default n
        help
            In the ESP32P4 and ESP32S31, the USB-DWC internal DMA can access external RAM. Enabling this
            configuration can save internal RAM by allocating the memory buffers used by the USB-DWC peripheral's
            DMA to external RAM. However, it introduces minor performance degradation due to the overhead of
            accessing external RAM.
        # Todo: IDF-11368 (aligned memory alloc size)

    # Hidden or compatibility options
    config USB_OTG_SUPPORTED
        # Invisible config kept for compatibility
        # Todo: Remove in v6.0 (IDF-8936)
        bool
        default y

endmenu #USB-OTG
```
